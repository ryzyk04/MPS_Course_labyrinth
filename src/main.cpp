#include <Arduino.h>
#include <Wire.h>
#include "puzzle_i2c.h"

// Временная общая I2C-шина через Uno wires: A4=SDA, A5=SCL, адрес 0x12.
PuzzleI2c bus;
bool gameActive = false;
uint32_t solvedAt = 0;

// Лабиринт, уровень 1, на матрице 8x8 (MAX7219) с 4 кнопками
//
// Матрица:      VCC -> 5V, GND -> GND, DIN -> 11, CS -> 10, CLK -> 13
// Кнопки:       вверх -> 2, вниз -> 3, влево -> 4, вправо -> 5
//               (вторым контактом каждой кнопки на GND)
// Светодиод:    пин 12 -> резистор -> светодиод (+), (-) -> GND

// ---------- Матрица ----------
const uint8_t PIN_DIN = 11;
const uint8_t PIN_CS  = 10;
const uint8_t PIN_CLK = 13;
const uint8_t BRIGHTNESS = 4;   // 0..15

// ---------- Светодиод-индикатор удара о стену ----------
const uint8_t PIN_ALERT_LED = 12;
const uint16_t ALERT_MS = 100;  // сколько горит после удара

// ---------- Светодиоды сложности ----------
const uint8_t PIN_LED_EASY   = 6;
const uint8_t PIN_LED_MEDIUM = 7;
const uint8_t PIN_LED_HARD   = 8;

// ---------- Кнопки (между пином и GND) ----------
const uint8_t PIN_UP    = 2;
const uint8_t PIN_DOWN  = 3;
const uint8_t PIN_LEFT  = 4;
const uint8_t PIN_RIGHT = 5;

const uint8_t BTN_PINS[4] = {PIN_UP, PIN_DOWN, PIN_LEFT, PIN_RIGHT};
const int8_t KEY_UP = 0, KEY_DOWN = 1, KEY_LEFT = 2, KEY_RIGHT = 3;

// ---------- Лабиринты: 9 лёгких (4x4), 9 средних (6x6), 9 сложных (8x8) ----------
// Координаты: (0, 0) - левый нижний угол, x растёт вправо, y растёт вверх.
// Стена стоит МЕЖДУ двумя соседними клетками и не даёт перейти между ними
// в обе стороны. Стены не отображаются, но игрока не пропускают.
// Все данные лежат во флеш-памяти (PROGMEM), в оперативную копируется только текущий уровень.
struct Wall { uint8_t x1, y1, x2, y2; };   // клетки по обе стороны стены

enum Difficulty : uint8_t { EASY, MEDIUM, HARD };

struct Level {
  uint8_t size;                // сторона лабиринта в клетках
  uint8_t difficulty;          // EASY / MEDIUM / HARD
  uint8_t startX, startY;
  uint8_t finishX, finishY;
  const Wall *walls;           // адрес массива стен во флеш-памяти
  uint8_t wallCount;
};

// EASY 1: старт (1, 2), финиш (3, 1)
const Wall WALLS_EASY_1[] PROGMEM = {
  {1, 3, 1, 2},
  {2, 3, 2, 2},
  {2, 2, 3, 2},
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  {3, 1, 3, 0},
};

// EASY 2: старт (1, 3), финиш (1, 0)
const Wall WALLS_EASY_2[] PROGMEM = {
  {0, 2, 1, 2},
  {0, 1, 1, 1},
  {1, 2, 1, 1},
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  {2, 0, 3, 0},
};

// EASY 3: старт (3, 1), финиш (0, 2)
const Wall WALLS_EASY_3[] PROGMEM = {
  {0, 3, 1, 3},
  {2, 3, 2, 2},
  {1, 2, 2, 2},
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  {0, 1, 0, 0},
};

// EASY 4: старт (3, 0), финиш (1, 3)
const Wall WALLS_EASY_4[] PROGMEM = {
  {0, 3, 1, 3},
  {3, 3, 3, 2},
  {1, 2, 2, 2},
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  {0, 2, 0, 1},
};

// EASY 5: старт (2, 1), финиш (3, 0)
const Wall WALLS_EASY_5[] PROGMEM = {
  {1, 3, 2, 3},
  {2, 3, 2, 2},
  {2, 2, 3, 2},
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  {0, 0, 1, 0},
};

// EASY 6: старт (0, 0), финиш (3, 2)
const Wall WALLS_EASY_6[] PROGMEM = {
  {0, 3, 1, 3},
  {1, 3, 1, 2},
  {2, 3, 2, 2},
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  {0, 0, 1, 0},
};

// EASY 7: старт (2, 2), финиш (0, 0)
const Wall WALLS_EASY_7[] PROGMEM = {
  {0, 3, 1, 3},
  {0, 2, 1, 2},
  {1, 3, 2, 3},
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  {2, 1, 2, 0},
};

// EASY 8: старт (1, 1), финиш (0, 3)
const Wall WALLS_EASY_8[] PROGMEM = {
  {2, 3, 3, 3},
  {2, 2, 3, 2},
  {1, 3, 1, 2},
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  {2, 1, 2, 0},
};

// EASY 9: старт (3, 3), финиш (1, 2)
const Wall WALLS_EASY_9[] PROGMEM = {
  {2, 3, 3, 3},
  {2, 2, 3, 2},
  {2, 1, 3, 1},
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  {1, 1, 1, 0},
};

// MEDIUM 1: старт (1, 2), финиш (3, 2)
const Wall WALLS_MEDIUM_1[] PROGMEM = {
  {0, 5, 1, 5},
  {0, 4, 1, 4},
  {0, 3, 1, 3},
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  {4, 1, 4, 0},
};

// MEDIUM 2: старт (4, 0), финиш (1, 4)
const Wall WALLS_MEDIUM_2[] PROGMEM = {
  {2, 5, 3, 5},
  {1, 4, 2, 4},
  {3, 3, 4, 3},
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  {4, 1, 4, 0},
};

// MEDIUM 3: старт (4, 5), финиш (0, 0)
const Wall WALLS_MEDIUM_3[] PROGMEM = {
  {2, 5, 3, 5},
  {1, 4, 2, 4},
  {3, 4, 4, 4},
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  {4, 1, 4, 0},
};

// MEDIUM 4: старт (0, 1), финиш (5, 5)
const Wall WALLS_MEDIUM_4[] PROGMEM = {
  {0, 4, 1, 4},
  {2, 4, 3, 4},
  {2, 3, 3, 3},
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  {4, 1, 4, 0},
};

// MEDIUM 5: старт (1, 4), финиш (5, 4)
const Wall WALLS_MEDIUM_5[] PROGMEM = {
  {1, 5, 2, 5},
  {1, 4, 2, 4},
  {3, 5, 4, 5},
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  {3, 1, 3, 0},
};

// MEDIUM 6: старт (5, 3), финиш (2, 3)
const Wall WALLS_MEDIUM_6[] PROGMEM = {
  {0, 5, 1, 5},
  {0, 4, 1, 4},
  {4, 5, 5, 5},
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  {4, 1, 4, 0},
};

// MEDIUM 7: старт (5, 1), финиш (3, 3)
const Wall WALLS_MEDIUM_7[] PROGMEM = {
  {0, 3, 1, 3},
  {0, 2, 1, 2},
  {3, 3, 4, 3},
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  {4, 1, 4, 0},
};

// MEDIUM 8: старт (4, 4), финиш (2, 0)
const Wall WALLS_MEDIUM_8[] PROGMEM = {
  {3, 5, 4, 5},
  {0, 4, 1, 4},
  {0, 3, 1, 3},
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  {5, 2, 5, 1},
};

// MEDIUM 9: старт (1, 3), финиш (4, 0)
const Wall WALLS_MEDIUM_9[] PROGMEM = {
  {2, 5, 3, 5},
  {1, 4, 2, 4},
  {0, 3, 1, 3},
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  {5, 1, 5, 0},
};

// HARD 1: старт (5, 1), финиш (1, 6)
const Wall WALLS_HARD_1[] PROGMEM = {
  {4, 7, 5, 7},
  {6, 7, 7, 7},
  {6, 6, 7, 6},
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  {6, 1, 6, 0},
};

// HARD 2: старт (0, 3), финиш (6, 4)
const Wall WALLS_HARD_2[] PROGMEM = {
  {2, 7, 3, 7},
  {2, 6, 3, 6},
  {2, 5, 3, 5},
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  {7, 1, 7, 0},
};

// HARD 3: старт (6, 6), финиш (5, 1)
const Wall WALLS_HARD_3[] PROGMEM = {
  {3, 7, 4, 7},
  {4, 6, 5, 6},
  {2, 6, 3, 6},
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  {7, 1, 7, 0},
};

// HARD 4: старт (0, 6), финиш (2, 0)
const Wall WALLS_HARD_4[] PROGMEM = {
  {4, 7, 5, 7},
  {0, 6, 1, 6},
  {1, 6, 2, 6},
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  {6, 1, 6, 0},
};

// HARD 5: старт (4, 1), финиш (0, 7)
const Wall WALLS_HARD_5[] PROGMEM = {
  {2, 7, 3, 7},
  {0, 6, 1, 6},
  {0, 5, 1, 5},
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  {5, 1, 5, 0},
};

// HARD 6: старт (4, 2), финиш (3, 6)
const Wall WALLS_HARD_6[] PROGMEM = {
  {0, 7, 1, 7},
  {6, 7, 7, 7},
  {1, 6, 2, 6},
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  {5, 1, 5, 0},
};

// HARD 7: старт (7, 4), финиш (7, 0)
const Wall WALLS_HARD_7[] PROGMEM = {
  {4, 7, 5, 7},
  {0, 6, 1, 6},
  {1, 6, 2, 6},
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  {3, 1, 3, 0},
};

// HARD 8: старт (1, 3), финиш (0, 4)
const Wall WALLS_HARD_8[] PROGMEM = {
  {3, 7, 4, 7},
  {4, 7, 5, 7},
  {4, 6, 5, 6},
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  {6, 1, 6, 0},
};

// HARD 9: старт (5, 7), финиш (3, 3)
const Wall WALLS_HARD_9[] PROGMEM = {
  {3, 7, 4, 7},
  {6, 7, 7, 7},
  {6, 6, 7, 6},
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  {2, 1, 2, 0},
};

#define WALLS_OF(w) w, sizeof(w) / sizeof(w[0])

const Level LEVELS[] PROGMEM = {
  {4, EASY, 1, 2, 3, 1, WALLS_OF(WALLS_EASY_1)},   // EASY 1
  {4, EASY, 1, 3, 1, 0, WALLS_OF(WALLS_EASY_2)},   // EASY 2
  {4, EASY, 3, 1, 0, 2, WALLS_OF(WALLS_EASY_3)},   // EASY 3
  {4, EASY, 3, 0, 1, 3, WALLS_OF(WALLS_EASY_4)},   // EASY 4
  {4, EASY, 2, 1, 3, 0, WALLS_OF(WALLS_EASY_5)},   // EASY 5
  {4, EASY, 0, 0, 3, 2, WALLS_OF(WALLS_EASY_6)},   // EASY 6
  {4, EASY, 2, 2, 0, 0, WALLS_OF(WALLS_EASY_7)},   // EASY 7
  {4, EASY, 1, 1, 0, 3, WALLS_OF(WALLS_EASY_8)},   // EASY 8
  {4, EASY, 3, 3, 1, 2, WALLS_OF(WALLS_EASY_9)},   // EASY 9
  {6, MEDIUM, 1, 2, 3, 2, WALLS_OF(WALLS_MEDIUM_1)},   // MEDIUM 1
  {6, MEDIUM, 4, 0, 1, 4, WALLS_OF(WALLS_MEDIUM_2)},   // MEDIUM 2
  {6, MEDIUM, 4, 5, 0, 0, WALLS_OF(WALLS_MEDIUM_3)},   // MEDIUM 3
  {6, MEDIUM, 0, 1, 5, 5, WALLS_OF(WALLS_MEDIUM_4)},   // MEDIUM 4
  {6, MEDIUM, 1, 4, 5, 4, WALLS_OF(WALLS_MEDIUM_5)},   // MEDIUM 5
  {6, MEDIUM, 5, 3, 2, 3, WALLS_OF(WALLS_MEDIUM_6)},   // MEDIUM 6
  {6, MEDIUM, 5, 1, 3, 3, WALLS_OF(WALLS_MEDIUM_7)},   // MEDIUM 7
  {6, MEDIUM, 4, 4, 2, 0, WALLS_OF(WALLS_MEDIUM_8)},   // MEDIUM 8
  {6, MEDIUM, 1, 3, 4, 0, WALLS_OF(WALLS_MEDIUM_9)},   // MEDIUM 9
  {8, HARD, 5, 1, 1, 6, WALLS_OF(WALLS_HARD_1)},   // HARD 1
  {8, HARD, 0, 3, 6, 4, WALLS_OF(WALLS_HARD_2)},   // HARD 2
  {8, HARD, 6, 6, 5, 1, WALLS_OF(WALLS_HARD_3)},   // HARD 3
  {8, HARD, 0, 6, 2, 0, WALLS_OF(WALLS_HARD_4)},   // HARD 4
  {8, HARD, 4, 1, 0, 7, WALLS_OF(WALLS_HARD_5)},   // HARD 5
  {8, HARD, 4, 2, 3, 6, WALLS_OF(WALLS_HARD_6)},   // HARD 6
  {8, HARD, 7, 4, 7, 0, WALLS_OF(WALLS_HARD_7)},   // HARD 7
  {8, HARD, 1, 3, 0, 4, WALLS_OF(WALLS_HARD_8)},   // HARD 8
  {8, HARD, 5, 7, 3, 3, WALLS_OF(WALLS_HARD_9)},   // HARD 9
};
const uint8_t LEVEL_COUNT = sizeof(LEVELS) / sizeof(LEVELS[0]);

const bool SHOW_FINISH = true;   // false - финиш скрыт: не рисуется и победа отключена

const uint16_t REPEAT_DELAY_MS = 250;  // через сколько удержание начинает повторяться
const uint16_t REPEAT_RATE_MS  = 150;  // и как часто потом

// ---------- Драйвер MAX7219 ----------
const uint8_t REG_DECODE    = 0x09;
const uint8_t REG_INTENSITY = 0x0A;
const uint8_t REG_SCANLIMIT = 0x0B;
const uint8_t REG_SHUTDOWN  = 0x0C;
const uint8_t REG_TEST      = 0x0F;

void send(uint8_t reg, uint8_t value) {
  digitalWrite(PIN_CS, LOW);
  shiftOut(PIN_DIN, PIN_CLK, MSBFIRST, reg);
  shiftOut(PIN_DIN, PIN_CLK, MSBFIRST, value);
  digitalWrite(PIN_CS, HIGH);
}

void showFrame(const uint8_t rows[8]) {
  for (uint8_t r = 0; r < 8; r++) send(r + 1, rows[r]);
}

// ---------- Кнопки ----------
// Возвращает номер нажатой кнопки (KEY_*) или -1
int8_t scanKey() {
  for (uint8_t i = 0; i < 4; i++) {
    if (digitalRead(BTN_PINS[i]) == LOW) return i;
  }
  return -1;
}

// ---------- Игра ----------
Level level;   // текущий лабиринт (копия из флеш-памяти)
int8_t levelIndex = -1;
uint8_t px = 0, py = 0;
int8_t lastKey = -1;
uint32_t keyTime = 0;      // когда клавиша была нажата
uint32_t lastRepeat = 0;
uint32_t alertUntil = 0;   // до какого момента горит светодиод-индикатор

// Есть ли стена между соседними клетками (в любую сторону)
bool wallBetween(uint8_t x1, uint8_t y1, uint8_t x2, uint8_t y2) {
  for (uint8_t i = 0; i < level.wallCount; i++) {
    Wall w;
    memcpy_P(&w, &level.walls[i], sizeof(Wall));
    if (w.x1 == x1 && w.y1 == y1 && w.x2 == x2 && w.y2 == y2) return true;
    if (w.x1 == x2 && w.y1 == y2 && w.x2 == x1 && w.y2 == y1) return true;
  }
  return false;
}

void tryMove(int8_t dx, int8_t dy) {
  if (!gameActive) return;
  int8_t nx = px + dx;
  int8_t ny = py + dy;
  bool outside = nx < 0 || nx >= level.size || ny < 0 || ny >= level.size;

  if (outside || wallBetween(px, py, nx, ny)) {
    bus.smallError();
    alertUntil = millis() + ALERT_MS;   // врезались - зажигаем светодиод
  } else {
    px = nx;
    py = ny;
  }
}

void handleKey(int8_t key) {
  if (key == KEY_UP)    tryMove(0, 1);
  if (key == KEY_DOWN)  tryMove(0, -1);
  if (key == KEY_LEFT)  tryMove(-1, 0);
  if (key == KEY_RIGHT) tryMove(1, 0);

  Serial.print("x=");
  Serial.print(px);
  Serial.print(" y=");
  Serial.println(py);
}

// Один из девяти лабиринтов выбранной сложности, воспроизводимо по сиду.
void pickLevel() {
  levelIndex = bus.status.difficulty * 9 + bus.status.seed % 9;
  memcpy_P(&level, &LEVELS[levelIndex], sizeof(Level));
  px = level.startX;
  py = level.startY;
  gameActive = true;
  lastKey = -1; keyTime = lastRepeat = millis(); alertUntil = 0;

  // светодиоды сложности: 6 - лёгкий, 7 - средний, 8 - сложный
  digitalWrite(PIN_LED_EASY,   level.difficulty == EASY);
  digitalWrite(PIN_LED_MEDIUM, level.difficulty == MEDIUM);
  digitalWrite(PIN_LED_HARD,   level.difficulty == HARD);

  Serial.print("Уровень сложности: ");
  Serial.print(level.difficulty == EASY ? "лёгкий" : level.difficulty == MEDIUM ? "средний" : "сложный");
  // Serial.print(" (лабиринт ");
  // Serial.print(levelIndex + 1);
  // Serial.print(" из ");
  // Serial.print(LEVEL_COUNT);
  // Serial.println(")");
}

void win() {
  gameActive = false;
  solvedAt = millis();
  bus.solved();
  Serial.println(F("SOLVED: жду следующую команду игры"));
}

void draw(uint32_t now) {
  uint8_t frame[8] = {0, 0, 0, 0, 0, 0, 0, 0};
  if (!gameActive) {
    bool solved = bus.status.state == ModuleBus::SOLVED;
    if (solved && (now - solvedAt >= 1600 || ((now - solvedAt) / 200) % 2 == 0))
      memset(frame, 255, sizeof(frame));
    showFrame(frame);
    return;
  }

  // стены не рисуем - о них сообщает только светодиод
  // финиш мигает
  if (SHOW_FINISH && (now / 300) % 2) frame[7 - level.finishY] |= 0x80 >> level.finishX;
  // игрок светится постоянно
  frame[7 - py] |= 0x80 >> px;   // строка 0 матрицы - верхняя, поэтому 7 - y

  showFrame(frame);
}

void setup() {
  Serial.begin(9600);
  pinMode(PIN_DIN, OUTPUT);
  pinMode(PIN_CS, OUTPUT);
  pinMode(PIN_CLK, OUTPUT);
  pinMode(PIN_ALERT_LED, OUTPUT);
  pinMode(PIN_LED_EASY, OUTPUT);
  pinMode(PIN_LED_MEDIUM, OUTPUT);
  pinMode(PIN_LED_HARD, OUTPUT);
  digitalWrite(PIN_CS, HIGH);

  for (uint8_t i = 0; i < 4; i++) pinMode(BTN_PINS[i], INPUT_PULLUP);

  send(REG_TEST, 0);
  send(REG_DECODE, 0);
  send(REG_SCANLIMIT, 7);
  send(REG_INTENSITY, BRIGHTNESS);
  send(REG_SHUTDOWN, 1);

  bus.begin(ModuleBus::LABYRINTH, ModuleBus::LABYRINTH_ADDRESS);
  draw(millis());
  Serial.println(F("WAITING_FOR_COMMAND: I2C 0x12, SDA=A4 SCL=A5"));
}

void loop() {
  uint32_t now = millis();
  PuzzleI2c::Action action = bus.update();
  if (action == PuzzleI2c::NEW_GAME) pickLevel();
  else if (action == PuzzleI2c::HALT) {
    gameActive = false;
    digitalWrite(PIN_LED_EASY, LOW); digitalWrite(PIN_LED_MEDIUM, LOW); digitalWrite(PIN_LED_HARD, LOW);
    digitalWrite(PIN_ALERT_LED, LOW);
  }
  if (!gameActive) { draw(now); return; }
  int8_t key = scanKey();

  if (key != lastKey) {
    lastKey = key;
    keyTime = now;
    lastRepeat = now;
    if (key >= 0) handleKey(key);
  } else if (key >= 0 && now - keyTime > REPEAT_DELAY_MS &&
             now - lastRepeat > REPEAT_RATE_MS) {
    lastRepeat = now;
    handleKey(key);   // повтор при удержании
  }

  digitalWrite(PIN_ALERT_LED, (int32_t)(alertUntil - now) > 0);

  if (SHOW_FINISH && px == level.finishX && py == level.finishY) win();

  draw(now);
  delay(2);
}
